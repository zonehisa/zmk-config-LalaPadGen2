## config/west.yml
```yaml
manifest:
  remotes:
    - name: zmkfirmware
      url-base: https://github.com/zmkfirmware
    - name: ShiniNet
      url-base: https://github.com/ShiniNet/
    - name: caksoylar
      url-base: https://github.com/caksoylar
    - name: zonehisa
      url-base: https://github.com/zonehisa
    - name: eswai
      url-base: https://github.com/eswai
  projects:
    - name: zmk
      remote: zmkfirmware
      revision: v0.3.0
      import: app/west.yml
    - name: zmk-driver-iqs9151
      remote: zonehisa
      revision: feature/pinch-zoom-keys
    - name: zmk-easy-charge-indicator
      remote: ShiniNet
      revision: main
    - name: zmk-rgbled-widget
      remote: caksoylar
      revision: v0.3
    - name: zmk-naginata
      remote: zonehisa
      revision: main
  self:
    path: config
```
